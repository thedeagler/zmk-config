/*
 * Copyright (c) 2020 Pete Johanson
 *
 * SPDX-License-Identifier: MIT
 */

#include "corne.dtsi"

&kscan0 {
	col-gpios
		= <&pro_micro_a  1 GPIO_ACTIVE_HIGH>
		, <&pro_micro_d 15 GPIO_ACTIVE_HIGH>
		;
};
