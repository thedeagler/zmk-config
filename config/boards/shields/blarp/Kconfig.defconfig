## config/boards/shields/blarp/Kconfig.defconfig
```kconfig
#Copyright (c) 2020 Derek Schmell
#SPDX-License-Identifier: MIT
 
 
if SHIELD_DOOKEEB_LEFT

config ZMK_KEYBOARD_NAME
	default "DooKeeb Left"

endif

if SHIELD_DOOKEEB_RIGHT

config ZMK_KEYBOARD_NAME
	default "DooKeeb Right"

endif

if SHIELD_DOOKEEB_LEFT || SHIELD_DOOKEEB_RIGHT

endif
```

## config/boards/shields/dookeeb/Kconfig.defconfig
```kconfig
#Copyright (c) 2020 Derek Schmell
#SPDX-License-Identifier: MIT
 
 
if SHIELD_DOOKEEB_LEFT

config ZMK_KEYBOARD_NAME
	default "DooKeeb Left"

config ZMK_SPLIT_BLE_ROLE_CENTRAL
	default y

endif

if SHIELD_DOOKEEB_RIGHT

config ZMK_KEYBOARD_NAME
	default "DooKeeb Right"

endif

if SHIELD_DOOKEEB_LEFT || SHIELD_DOOKEEB_RIGHT

config ZMK_SPLIT
	default y

endif
```

## config/boards/shields/dookeeb/Kconfig.shield
```kconfig
# Copyright (c) 2020 Derek Schmell
# SPDX-License-Identifier: MIT

config SHIELD_DOOKEEB_LEFT
	def_bool $(shields_list_contains,dookeeb_left)

config SHIELD_DOOKEEB_RIGHT
	def_bool $(shields_list_contains,dookeeb_right)
```

## config/boards/shields/oledtest/Kconfig.defconfig
```kconfig
#Copyright (c) 2020 Derek Schmell
#SPDX-License-Identifier: MIT
 
 
if SHIELD_OLEDTEST

config ZMK_KEYBOARD_NAME
	default "Oled Test"

endif

if SHIELD_OLEDTEST

endif
```

## config/boards/shields/oledtest/Kconfig.shield
```kconfig
# Copyright (c) 2020 Derek Schmell
# SPDX-License-Identifier: MIT

config SHIELD_OLEDTEST
	def_bool $(shields_list_contains,oledtest)
```
