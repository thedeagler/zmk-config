/*
 * Copyright (c) 2020 Derek Schmell
 *
 * SPDX-License-Identifier: MIT
 */

#include "dookeeb.dtsi"

&kscan0 {
	col-gpios
		= <&pro_micro_a  2 GPIO_ACTIVE_HIGH> // c0
		, <&pro_micro_a  1 GPIO_ACTIVE_HIGH> // c1
		, <&pro_micro_d  3 GPIO_ACTIVE_HIGH> // c2
		, <&pro_micro_d  4 GPIO_ACTIVE_HIGH> // c3
		, <&pro_micro_d  5 GPIO_ACTIVE_HIGH> // c4
		, <&pro_micro_d  6 GPIO_ACTIVE_HIGH> // c5
		, <&pro_micro_d  7 GPIO_ACTIVE_HIGH> // c6
		, <&pro_micro_d  8 GPIO_ACTIVE_HIGH> // c7
		, <&pro_micro_d  9 GPIO_ACTIVE_HIGH> // c8
		;
};

