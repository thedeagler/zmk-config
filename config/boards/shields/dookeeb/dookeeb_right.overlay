/*
 * Copyright (c) 2020 Derek Schmell
 *
 * SPDX-License-Identifier: MIT
 */
 
#include "dookeeb.dtsi"

&default_transform {
	col-offset = <9>;
};

&kscan0 {
	debounce-period: 7;
	
	col-gpios
		= <&pro_micro_d 10 GPIO_ACTIVE_HIGH> // c0
		, <&pro_micro_d 16 GPIO_ACTIVE_HIGH> // c1
		, <&pro_micro_d 14 GPIO_ACTIVE_HIGH> // c2
		, <&pro_micro_d 15 GPIO_ACTIVE_HIGH> // c3
		, <&pro_micro_a  0 GPIO_ACTIVE_HIGH> // c4
		, <&pro_micro_a  1 GPIO_ACTIVE_HIGH> // c5
		, <&pro_micro_a  2 GPIO_ACTIVE_HIGH> // c6
		, <&pro_micro_d  3 GPIO_ACTIVE_HIGH> // c7
		, <&pro_micro_d  4 GPIO_ACTIVE_HIGH> // c8
		;
	
	row-gpios
		= <&pro_micro_a 3 (GPIO_ACTIVE_HIGH | GPIO_PULL_DOWN)> // r0
		, <&pro_micro_d 6 (GPIO_ACTIVE_HIGH | GPIO_PULL_DOWN)> // r1
		, <&pro_micro_d 7 (GPIO_ACTIVE_HIGH | GPIO_PULL_DOWN)> // r2
		, <&pro_micro_d 8 (GPIO_ACTIVE_HIGH | GPIO_PULL_DOWN)> // r3
		, <&pro_micro_d 9 (GPIO_ACTIVE_HIGH | GPIO_PULL_DOWN)> // r4
		, <&pro_micro_d 5 (GPIO_ACTIVE_HIGH | GPIO_PULL_DOWN)> // r5
		;
};